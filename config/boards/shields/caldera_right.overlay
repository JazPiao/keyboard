#include "caldera.dtsi"

&default_transform { 
    col-offset = <6>;
};

&kscan0 {
    col-gpios
        = <&nice!nano 17 GPIO_ACTIVE_HIGH>
        , <&nice!nano 11 GPIO_ACTIVE_HIGH>
        , <&nice!nano 100 GPIO_ACTIVE_HIGH>
        , <&nice!nano 24 GPIO_ACTIVE_HIGH>
        , <&nice!nano 22 GPIO_ACTIVE_HIGH>
        , <&nice!nano 20 GPIO_ACTIVE_HIGH>
        ;
};
