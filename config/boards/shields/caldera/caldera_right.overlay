#include "caldera.dtsi"

&default_transform { 
    col-offset = <6>;
};

&kscan0 {
    col-gpios
        = <&pro_micro 0 17 GPIO_ACTIVE_HIGH>
        , <&pro_micro 0 11 GPIO_ACTIVE_HIGH>
        , <&pro_micro 1 00 GPIO_ACTIVE_HIGH>
        , <&pro_micro 0 24 GPIO_ACTIVE_HIGH>
        , <&pro_micro 0 22 GPIO_ACTIVE_HIGH>
        , <&pro_micro 0 20 GPIO_ACTIVE_HIGH>
        ;
};
