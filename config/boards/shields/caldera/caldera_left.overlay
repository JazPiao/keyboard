#include "caldera.dtsi"

&kscan0 {
    col-gpios
        = <&pro_micro 20 GPIO_ACTIVE_HIGH>
        , <&pro_micro 22 GPIO_ACTIVE_HIGH>
        , <&pro_micro 24 GPIO_ACTIVE_HIGH>
        , <&pro_micro 100 GPIO_ACTIVE_HIGH>
        , <&pro_micro 111 GPIO_ACTIVE_HIGH>
        , <&pro_micro 20 GPIO_ACTIVE_HIGH>
        ;
};

